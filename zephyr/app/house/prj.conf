## CMakeLists.txt
```
cmake_minimum_required(VERSION 3.20.0)
find_package(Zephyr REQUIRED HINTS $ENV{ZEPHYR_BASE})
project(house LANGUAGES C CXX)

# TensorFlow Lite Micro: west-Modul aus zephyr/manifest/west.yml (Chirale_TensorFlowLite v2.0.0)
set(TFLM_DIR "${ZEPHYR_BASE}/../modules/lib/chirale-tflm/src" CACHE PATH "TFLM-Quellbaum")
file(GLOB_RECURSE TFLM_SRC
  ${TFLM_DIR}/tensorflow/*.cpp ${TFLM_DIR}/tensorflow/*.cc ${TFLM_DIR}/tensorflow/*.c
  ${TFLM_DIR}/third_party/cmsis_nn/Source/*.c)
list(FILTER TFLM_SRC EXCLUDE REGEX "system_setup\\.cpp$|/peripherals/|_test\\.(cpp|cc)$|/testing/|/benchmarks/|/examples/")
target_sources(app PRIVATE ${TFLM_SRC})
set_source_files_properties(${TFLM_SRC} PROPERTIES COMPILE_OPTIONS
  "-Wno-unused-parameter;-Wno-sign-compare;-Wno-missing-field-initializers;-Wno-unused-variable;-Wno-deprecated-declarations;-Wno-unused-function")
# Modell und Merkmalskonfiguration direkt aus der Trainings-Pipeline (eine Quelle, keine Kopien)
zephyr_include_directories(${CMAKE_CURRENT_SOURCE_DIR}/../../../ml/clap/out)
zephyr_include_directories(
  ${TFLM_DIR} ${TFLM_DIR}/third_party/flatbuffers/include ${TFLM_DIR}/third_party/gemmlowp ${TFLM_DIR}/third_party/ruy
  ${TFLM_DIR}/third_party/kissfft ${TFLM_DIR}/third_party/cmsis_nn ${TFLM_DIR}/third_party/cmsis_nn/Include ${TFLM_DIR}/third_party/cmsis/CMSIS/Core/Include)
zephyr_compile_definitions(TF_LITE_STATIC_MEMORY TF_LITE_STRIP_ERROR_STRINGS TF_LITE_MCU_DEBUG_LOG CMSIS_NN ARDUINO=100 ARDUINO_EXCLUDE_CODE)

set(HAL_DIR ${ZEPHYR_HAL_INFINEON_MODULE_DIR}/mtb-hal-cat1)
set(PDL_DIR ${ZEPHYR_HAL_INFINEON_MODULE_DIR}/mtb-pdl-cat1)
target_sources(app PRIVATE
  src/main.c src/bt_presence.c src/clap.cpp src/mic.c src/cyhal_dma_stub.c
  ${HAL_DIR}/source/cyhal_pdmpcm.c ${HAL_DIR}/source/cyhal_audio_common.c ${PDL_DIR}/drivers/source/cy_pdm_pcm.c)
```

## Kconfig
```
# Einstellungen der Anwendung house. Die Handy-Adressen gehoeren nicht ins Repo: in phones.conf eintragen
# (Vorlage phones.conf.example) und mit  west build ... -- -DEXTRA_CONF_FILE=phones.conf  bauen.
mainmenu "House: Klatschen + Bluetooth-Anwesenheit"

config HOUSE_PHONES
	string "Klassische Bluetooth-Adressen der Handys, kommagetrennt"
	default ""
	help
	  Bis zu 8 Adressen der Form AA:BB:CC:DD:EE:FF, durch Komma getrennt. Android: Einstellungen >
	  Ueber das Telefon > Status > Bluetooth-Adresse. Anwesend = mindestens eines der Handys antwortet
	  auf das Paging; abwesend = keines antwortet in zwei Runden hintereinander.

config HOUSE_PAGE_INTERVAL_MS
	int "Abstand der Paging-Runden in ms"
	default 5000
	help
	  Eine Runde pagt alle Handys nacheinander. Dauert die Runde laenger (abwesende Handys kosten je
	  HOUSE_PAGE_TIMEOUT_MS), folgt die naechste sofort.

config HOUSE_PAGE_TIMEOUT_MS
	int "Page-Timeout des Controllers je Versuch in ms"
	default 2000
	range 625 10000
	help
	  So lange wartet der Bluetooth-Controller auf die Antwort eines Handys (HCI Write Page Timeout).
	  Handys in Reichweite antworten in 0,3 bis 0,7 s. Der Standard des Controllers waere 5120 ms.

config HOUSE_FAIL_LIMIT
	int "Fehlrunden in Folge, bis ein Handy als abwesend gilt"
	default 2
	range 1 10
	help
	  Mit 2 fuehrt ein einzelner verpasster Versuch nicht zum Abschalten. Abwesenheit wird dann nach
	  etwa FAIL_LIMIT Runden gemeldet, bei drei abwesenden Handys und den Standardwerten nach 12 bis 18 s.

source "Kconfig.zephyr"
```

## prj.conf
```kconfig
# Gemeinsame Firmware: Bluetooth-Anwesenheit (HCI-Rohmodus, Paging) + Klatsch-Modell (Mikrofon, TFLM)
CONFIG_GPIO=y
CONFIG_SERIAL=y
CONFIG_UART_INTERRUPT_DRIVEN=y
CONFIG_CONSOLE=y
CONFIG_UART_CONSOLE=y
CONFIG_PRINTK=y
CONFIG_LOG=y
CONFIG_LOG_DEFAULT_LEVEL=2
CONFIG_LOG_MODE_IMMEDIATE=y

CONFIG_BT=y
CONFIG_BT_HCI_RAW=y
# Remote Name Request Complete ist 255 Bytes gross (248 Byte Name); Standardpuffer waere 70
CONFIG_BT_BUF_EVT_RX_SIZE=255
CONFIG_BT_BUF_EVT_RX_COUNT=10
CONFIG_BT_BUF_ACL_TX_COUNT=2
CONFIG_BT_AIROC=y
CONFIG_CYW43439=y
CONFIG_BT_H4=y
CONFIG_AIROC_AUTOBAUD_MODE=n
CONFIG_BT_HCI_DRIVER_LOG_LEVEL_INF=y

CONFIG_MAIN_STACK_SIZE=8192
CONFIG_HEAP_MEM_POOL_SIZE=16384

# Audio und Modell (aus clap_model)
CONFIG_FPU=y
CONFIG_CBPRINTF_FP_SUPPORT=y
CONFIG_CPP=y
CONFIG_STD_CPP17=y
CONFIG_GLIBCXX_LIBCPP=y
CONFIG_CPP_EXCEPTIONS=n
CONFIG_CPP_RTTI=n

# Hauptthread (Bluetooth) unter dem Audio-Thread (Prioritaet 5)
CONFIG_MAIN_THREAD_PRIORITY=7

# Ausgaben beider Threads nicht ineinander verschraenken (Zeilen muessen fuer den Viewer ganz bleiben)
CONFIG_PRINTK_SYNC=y
```

## src/main.c
```c
/*
 * Gemeinsame Firmware "house": Bluetooth-Anwesenheit (Paging, HCI-Rohmodus) und Klatsch-Erkennung
 * (Mikrofon, Merkmale, TensorFlow Lite Micro) laufen parallel in zwei Threads.
 *
 * Verhalten: Klatschen schaltet das Licht (LED1) um. Verlaesst das Handy das Haus (Bluetooth nicht mehr
 * erreichbar), geht das Licht aus. Kommt das Handy zurueck, bleibt das Licht aus, bis geklatscht wird.
 * LED2 zeigt die Anwesenheit. Konsole: Zeilen beider Teile (P,/PAGE/PRAESENZ und L,/MODELL/KLATSCH), dazu
 * "LICHT an|aus <grund>".
 */
#include <zephyr/kernel.h>
#include <zephyr/drivers/gpio.h>
#include <zephyr/sys/printk.h>
#include "house.h"

static const struct gpio_dt_spec led1 = GPIO_DT_SPEC_GET(DT_ALIAS(led0), gpios);       /* Licht */
static const struct gpio_dt_spec led2 = GPIO_DT_SPEC_GET(DT_NODELABEL(user_led1), gpios); /* Anwesenheit */
static K_MUTEX_DEFINE(lock);
static bool light = false, present = false;

void house_init(void)
{
	gpio_pin_configure_dt(&led1, GPIO_OUTPUT_INACTIVE);
	gpio_pin_configure_dt(&led2, GPIO_OUTPUT_INACTIVE);
}

static void apply(const char *why)
{
	gpio_pin_set_dt(&led1, light ? 1 : 0);
	gpio_pin_set_dt(&led2, present ? 1 : 0);
	printk("LICHT %s  (%s)\n", light ? "an" : "aus", why);
}

void house_set_presence(bool p)
{
	k_mutex_lock(&lock, K_FOREVER);
	bool was = present; present = p;
	if (was && !p && light) { light = false; apply("Handy weg"); }
	else gpio_pin_set_dt(&led2, present ? 1 : 0);
	k_mutex_unlock(&lock);
}

bool house_toggle_light(void)
{
	k_mutex_lock(&lock, K_FOREVER);
	light = !light; apply("Klatschen");
	bool l = light;
	k_mutex_unlock(&lock);
	return l;
}

bool house_light(void) { return light; }
bool house_present(void) { return present; }

K_THREAD_STACK_DEFINE(audio_stack, 16384);
static struct k_thread audio_thread;

int main(void)
{
	printk("\nHouse: Bluetooth-Anwesenheit + Klatsch-Modell (Zephyr)\n");
	house_init();
	/* Audio-Thread (Prioritaet 5) hoeher als der Bluetooth-Thread im Hauptthread (Prioritaet 7, prj.conf),
	 * damit das Mikrofon-FIFO (256 Woerter = 16 ms) beim Firmware-Download und Paging nicht ueberlaeuft */
	k_thread_create(&audio_thread, audio_stack, K_THREAD_STACK_SIZEOF(audio_stack), clap_thread, NULL, NULL, NULL, 5, 0, K_NO_WAIT);
	k_thread_name_set(&audio_thread, "audio");
	bt_presence_thread(NULL, NULL, NULL);   /* laeuft im Hauptthread weiter */
	return 0;
}
```

## src/bt_presence.c
```c
/*
 * Anwesenheit per klassischem Bluetooth (BR/EDR) im HCI-Rohmodus, ohne App auf dem Handy.
 *
 * Jedes Handy hat eine feste klassische Bluetooth-Adresse. Das Board schickt alle PAGE_INTERVAL_MS an jede
 * Adresse aus CONFIG_HOUSE_PHONES (phones.conf, bis zu 8 Handys) einen Remote Name Request ("Paging").
 * Antwortet ein Handy, ist es in Reichweite und Bluetooth an; Status 0x04 (Page Timeout) heisst: weg oder
 * Bluetooth aus. Kopplungsanfragen werden negativ beantwortet, es bleibt bei einem kurzen Funkkontakt ohne
 * Dialog. Anwesend = mindestens ein Handy antwortet; abwesend = keines in FAIL_LIMIT Runden hintereinander.
 *
 * Warum Rohmodus: Zephyrs experimenteller klassischer Host friert bei der ersten erfolgreichen
 * Verbindung ein (Protokoll Abschnitt 66). Hier spricht die Anwendung den Controller direkt an.
 *
 * Konsole (J1, 115200), Zeilen passend zu tools/live_viewer.py (Modus Anwesenheit):
 *   AP ssid=BT-Paging ip=none kanal=0
 *   PAGE ok <ms> <adresse> Name: <name> | PAGE fail 0x<status> ... <adresse> | PAGE timeout <adresse>   je Versuch
 *   CLIENT join|leave <adresse> je Handy, PRAESENZ an|aus clients=<anzahl erreichbar> ..., P,<-50|-100>,<anzahl>
 */
#include <zephyr/kernel.h>
#include <zephyr/bluetooth/hci_raw.h>
#include <zephyr/bluetooth/hci_types.h>
#include <zephyr/bluetooth/buf.h>
#include <zephyr/bluetooth/addr.h>
#include <zephyr/net_buf.h>
#include <zephyr/sys/byteorder.h>
#include <zephyr/drivers/gpio.h>
#include <zephyr/drivers/bluetooth.h>
#include <zephyr/sys/printk.h>
#include <string.h>
#include <stdlib.h>
#include "house.h"

/* ---- Einstellungen ---- */
#define MAX_PHONES        8
#define PAGE_INTERVAL_MS  CONFIG_HOUSE_PAGE_INTERVAL_MS   /* Abstand der Runden (eine Runde pagt alle Handys nacheinander) */
#define FAIL_LIMIT        CONFIG_HOUSE_FAIL_LIMIT         /* so viele Fehlrunden in Folge = dieses Handy abwesend */
#define PAGE_TIMEOUT_MS   CONFIG_HOUSE_PAGE_TIMEOUT_MS    /* Page-Timeout des Controllers (HCI Write Page Timeout) */
#define CONN_WAIT_MS      (PAGE_TIMEOUT_MS + 2000)        /* laenger als der Page-Timeout, sonst Abbruch durch uns */

struct phone { bt_addr_t addr; char str[18]; bool present; int fails; };
static struct phone phones[MAX_PHONES];
static int n_phones = 0;

static K_FIFO_DEFINE(rx_queue);

/* ---- Nachbildung zweier Host-Funktionen, die der Infineon-Treiber beim Firmware-Download braucht.
 * Im Rohmodus gibt es keinen Host; der Treiber ruft sie waehrend bt_hci_setup() auf. Semantik wie im Host:
 * alloc reserviert Platz fuer den Kommando-Header, send_sync setzt ihn, sendet und wartet auf
 * Command Complete oder Command Status mit passendem Opcode. ---- */
static uint8_t evt_wait(k_timeout_t timeout, uint8_t *out, uint8_t *outlen);

/* Im Rohmodus legt bt_buf_get_tx das H4-Typbyte (0x01) als erstes Datenbyte ab. Dahinter kommt der
 * Kommando-Header (Opcode, Laenge), den send_sync spaeter fuellt, danach die Parameter des Treibers. */
struct net_buf *bt_hci_cmd_alloc(k_timeout_t timeout)
{
	struct net_buf *buf = bt_buf_get_tx(BT_BUF_CMD, timeout, NULL, 0);
	if (buf) memset(net_buf_add(buf, sizeof(struct bt_hci_cmd_hdr)), 0, sizeof(struct bt_hci_cmd_hdr));
	return buf;
}

int bt_hci_cmd_send_sync(uint16_t opcode, struct net_buf *buf, struct net_buf **rsp)
{
	if (!buf) { buf = bt_hci_cmd_alloc(K_FOREVER); if (!buf) return -ENOBUFS; }
	struct bt_hci_cmd_hdr *hdr = (struct bt_hci_cmd_hdr *)&buf->data[1];   /* hinter dem H4-Typbyte */
	hdr->opcode = sys_cpu_to_le16(opcode);
	hdr->param_len = buf->len - 1 - sizeof(*hdr);
	int err = bt_send(buf);
	if (err) { printk("  send_sync 0x%04x: bt_send %d\n", opcode, err); return err; }
	uint8_t ev[64], n;
	for (int i = 0; i < 50; i++) {
		uint8_t code = evt_wait(K_MSEC(2000), ev, &n);
		if (code == 0) { printk("  send_sync 0x%04x: kein Ereignis (Timeout)\n", opcode); return -EIO; }
		if (opcode == BT_HCI_OP_RESET) printk("  send_sync 0x%04x: Ereignis 0x%02x len %u\n", opcode, code, n);
		if (code == BT_HCI_EVT_CMD_COMPLETE && n >= 4 && sys_get_le16(&ev[1]) == opcode) {
			if (rsp) *rsp = NULL;
			return ev[3] == 0 ? 0 : -EIO;
		}
		if (code == BT_HCI_EVT_CMD_STATUS && n >= 4 && sys_get_le16(&ev[2]) == opcode) {
			if (rsp) *rsp = NULL;
			return ev[0] == 0 ? 0 : -EIO;
		}
	}
	return -ETIMEDOUT;
}

static int addr_from_str(const char *str, bt_addr_t *addr)
{
	/* "AA:BB:CC:DD:EE:FF" -> val[5]..val[0] (Little Endian wie im HCI) */
	if (strlen(str) != 17) return -1;
	for (int i = 0; i < 6; i++) {
		char h[3] = { str[i * 3], str[i * 3 + 1], 0 };
		if (i < 5 && str[i * 3 + 2] != ':') return -1;
		addr->val[5 - i] = (uint8_t)strtoul(h, NULL, 16);
	}
	return 0;
}
static bool present = false;
static uint32_t attempts = 0;

static int hci_cmd(uint16_t opcode, const void *params, uint8_t len)
{
	struct net_buf *buf = bt_buf_get_tx(BT_BUF_CMD, K_FOREVER, NULL, 0);
	struct bt_hci_cmd_hdr *hdr = net_buf_add(buf, sizeof(*hdr));
	hdr->opcode = sys_cpu_to_le16(opcode);
	hdr->param_len = len;
	if (len) net_buf_add_mem(buf, params, len);
	return bt_send(buf);
}

static void neg_reply(uint16_t opcode, const bt_addr_t *addr)
{
	hci_cmd(opcode, addr, sizeof(*addr));
}

/* Ereignisse abholen; liefert Ereigniscode oder 0 bei Timeout. Payload wird nach *out kopiert. */
static uint8_t evt_wait(k_timeout_t timeout, uint8_t *out, uint8_t *outlen)
{
	struct net_buf *buf = k_fifo_get(&rx_queue, timeout);
	if (!buf) return 0;
	uint8_t code = 0;
	if (buf->len >= 1 + sizeof(struct bt_hci_evt_hdr) && net_buf_pull_u8(buf) == BT_HCI_H4_EVT) {
		struct bt_hci_evt_hdr *hdr = net_buf_pull_mem(buf, sizeof(*hdr));
		code = hdr->evt;
		uint8_t n = buf->len < 64 ? buf->len : 64;
		memcpy(out, buf->data, n); *outlen = n;
	}
	net_buf_unref(buf);
	return code;
}

/* Sicherheitsanfragen des Gegenuebers waehrend des kurzen Kontakts: alle ablehnen */
static void handle_security_event(uint8_t code, const uint8_t *p)
{
	bt_addr_t a; memcpy(&a, p, 6);
	if (code == BT_HCI_EVT_LINK_KEY_REQ)      neg_reply(BT_HCI_OP_LINK_KEY_NEG_REPLY, &a);
	else if (code == BT_HCI_EVT_PIN_CODE_REQ) neg_reply(BT_HCI_OP_PIN_CODE_NEG_REPLY, &a);
	else if (code == BT_HCI_EVT_IO_CAPA_REQ) {
		struct { bt_addr_t bdaddr; uint8_t reason; } __packed r = { .reason = 0x18 /* pairing not allowed */ };
		memcpy(&r.bdaddr, &a, 6);
		hci_cmd(BT_OP(BT_OGF_LINK_CTRL, 0x0034) /* IO Capability Request Negative Reply */, &r, sizeof(r));
	}
}

/* Page-Timeout des Controllers setzen (Einheit 0,625 ms); Standard waere 0x2000 = 5,12 s */
static int hci_set_page_timeout(uint32_t ms)
{
	uint16_t v = sys_cpu_to_le16((uint16_t)(ms * 1000 / 625));
	struct net_buf *buf = bt_hci_cmd_alloc(K_FOREVER);
	if (!buf) return -ENOBUFS;
	net_buf_add_mem(buf, &v, sizeof(v));
	return bt_hci_cmd_send_sync(BT_OP(BT_OGF_BASEBAND, 0x0018), buf, NULL);
}

static int hci_reset(void)
{
	uint8_t ev[64], n;
	hci_cmd(BT_HCI_OP_RESET, NULL, 0);
	for (int i = 0; i < 10; i++) {
		uint8_t code = evt_wait(K_MSEC(2000), ev, &n);
		if (code == 0) return -1;
		if (code == BT_HCI_EVT_CMD_COMPLETE && n >= 4 && sys_get_le16(&ev[1]) == BT_HCI_OP_RESET) return ev[3] == 0 ? 0 : -2;
	}
	return -3;
}

/* Ein Paging-Versuch per Remote Name Request: true = Handy erreichbar.
 * Das Kommando pagt die Adresse und holt nur den Geraetenamen, ohne ACL-Datenverbindung und ohne
 * Kopplung (so arbeitet auch "hcitool name"). Antwort: Remote Name Request Complete (0x07) mit
 * Status 0 (da) oder 0x04 Page Timeout (weg oder Bluetooth aus). */
#define OP_REMOTE_NAME_REQ        BT_OP(BT_OGF_LINK_CTRL, 0x0019)
#define OP_REMOTE_NAME_REQ_CANCEL BT_OP(BT_OGF_LINK_CTRL, 0x001a)
#define EVT_REMOTE_NAME_COMPLETE  0x07

static bool page_once(struct phone *ph)
{
	attempts++;
	struct { bt_addr_t bdaddr; uint8_t pscan_rep_mode; uint8_t reserved; uint16_t clock_offset; } __packed cp = { .pscan_rep_mode = 0x01 };
	bt_addr_copy(&cp.bdaddr, &ph->addr);
	int64_t t0 = k_uptime_get();
	hci_cmd(OP_REMOTE_NAME_REQ, &cp, sizeof(cp));

	uint8_t ev[64], n; int result = -1;
	int64_t deadline = t0 + CONN_WAIT_MS;
	while (k_uptime_get() < deadline) {
		int64_t left = deadline - k_uptime_get();
		uint8_t code = evt_wait(K_MSEC(left > 0 ? left : 1), ev, &n);
		if (code == 0) continue;                       /* Nicht-Ereignis (z. B. ACL) oder Timeout der Wartezeit */
		if (code == BT_HCI_EVT_CMD_STATUS && n >= 4) {
			if (ev[0] != 0) { printk("PAGE fail (cmd status 0x%02x) %s\n", ev[0], ph->str); return false; }
		} else if (code == EVT_REMOTE_NAME_COMPLETE && n >= 7) {
			result = ev[0];
			if (result == 0) { ev[n < 64 ? n : 63] = 0; printk("PAGE ok %lld ms  %s  Name: %s\n", k_uptime_get() - t0, ph->str, (const char *)&ev[7]); }
			else printk("PAGE fail 0x%02x nach %lld ms  %s\n", result, k_uptime_get() - t0, ph->str);
			break;
		} else if (code == BT_HCI_EVT_LINK_KEY_REQ || code == BT_HCI_EVT_PIN_CODE_REQ || code == BT_HCI_EVT_IO_CAPA_REQ) {
			handle_security_event(code, ev);
		}
	}
	if (result < 0) {
		printk("PAGE timeout  %s\n", ph->str);
		hci_cmd(OP_REMOTE_NAME_REQ_CANCEL, &ph->addr, sizeof(ph->addr));
		for (int i = 0; i < 5; i++) { uint8_t c = evt_wait(K_MSEC(1000), ev, &n); if (c == EVT_REMOTE_NAME_COMPLETE || c == 0) break; }
		return false;
	}
	return result == 0;
}

static int n_present(void) { int n = 0; for (int i = 0; i < n_phones; i++) if (phones[i].present) n++; return n; }

/* Zustand eines Handys setzen; die Gesamtanwesenheit (mindestens eines erreichbar) geht an die Hauslogik */
static void set_phone_present(struct phone *ph, bool on)
{
	if (on == ph->present) return;
	ph->present = on;
	printk("CLIENT %s %s\n", on ? "join" : "leave", ph->str);
	int n = n_present(); bool any = n > 0;
	if (any != present) { present = any; house_set_presence(any); }
	if (any) { const char *first = ""; for (int i = 0; i < n_phones; i++) if (phones[i].present) { first = phones[i].str; break; }
		printk("PRAESENZ an  clients=%d  rssi=-50 dBm  %s\n", n, first); }
	else printk("PRAESENZ aus  clients=0\n");
}

static int parse_phones(const char *list)
{
	char buf[MAX_PHONES * 20]; strncpy(buf, list, sizeof(buf) - 1); buf[sizeof(buf) - 1] = 0;
	for (char *tok = strtok(buf, ", "); tok && n_phones < MAX_PHONES; tok = strtok(NULL, ", ")) {
		struct phone *ph = &phones[n_phones];
		if (addr_from_str(tok, &ph->addr)) { printk("FEHLER: Adresse ungueltig: %s\n", tok); return -1; }
		strncpy(ph->str, tok, 17); ph->str[17] = 0; ph->present = false; ph->fails = 0; n_phones++;
	}
	return n_phones ? 0 : -1;
}


void bt_presence_thread(void *a, void *b, void *c)
{
	(void)a; (void)b; (void)c;
	printk("BT: Anwesenheit per Paging (HCI-Rohmodus)\n");
	if (parse_phones(CONFIG_HOUSE_PHONES)) { printk("FEHLER: keine gueltige Handy-Adresse (CONFIG_HOUSE_PHONES, siehe phones.conf.example)\n"); return; }
	int err = bt_enable_raw(&rx_queue);
	printk("bt_enable_raw -> %d\n", err);
	if (err) { for (;;) { k_msleep(100); } }
	/* Im Rohmodus ruft Zephyr die Treiber-Einrichtung (Firmware-Download, Baudraten) nicht auf: selbst machen */
	const struct device *hci = DEVICE_DT_GET(DT_CHOSEN(zephyr_bt_hci));
	struct bt_hci_setup_params sp = { 0 };
	err = bt_hci_setup(hci, &sp);
	printk("bt_hci_setup (Firmware-Download) -> %d\n", err);
	if (err) { for (;;) { k_msleep(100); } }
	err = hci_reset();
	printk("HCI Reset -> %d\n", err);
	if (err) { for (;;) { k_msleep(200); } }
	err = hci_set_page_timeout(PAGE_TIMEOUT_MS);
	printk("Page-Timeout %d ms -> %d\n", PAGE_TIMEOUT_MS, err);
	printk("Bluetooth bereit (Controller direkt)\n");
	printk("AP ssid=BT-Paging ip=none kanal=0\n");
	printk("Ziel: %d Handy(s), alle %d s eine Paging-Runde, Page-Timeout %d ms, %d Fehlrunden = abwesend\n", n_phones, PAGE_INTERVAL_MS / 1000, PAGE_TIMEOUT_MS, FAIL_LIMIT);
	for (int i = 0; i < n_phones; i++) printk("  Handy %d: %s\n", i + 1, phones[i].str);

	int64_t next = k_uptime_get();
	uint32_t ticks = 0;
	for (;;) {
		int64_t now = k_uptime_get();
		if (now >= next) {
			next = now + PAGE_INTERVAL_MS;
			for (int i = 0; i < n_phones; i++) {
				struct phone *ph = &phones[i];
				if (page_once(ph)) { ph->fails = 0; set_phone_present(ph, true); }
				else { ph->fails++; if (ph->fails >= FAIL_LIMIT) set_phone_present(ph, false); }
			}
		}
		/* zwischendurch eintreffende Ereignisse (z. B. verspaetete) leeren */
		uint8_t ev[64], n; while (evt_wait(K_NO_WAIT, ev, &n)) { }
		printk("P,%d,%d\n", present ? -50 : -100, n_present());
		/* AP-Zeile jede Minute wiederholen, damit ein spaeter gestarteter Viewer den Modus erkennt */
		if (++ticks % 60 == 0) printk("AP ssid=BT-Paging ip=none kanal=0\n");
		k_msleep(1000);
	}
}
```

## src/clap.cpp
```c
/*
 * Doppelklatschen erkennen mit dem selbst trainierten Modell, unter Zephyr (aus arduino/sketchbook/05-clap-model).
 *
 * Audio-Thread: Mikrofon ueber die Infineon-HAL (mic.c), je 16-ms-Rahmen Hann, FFT 256, 32 Mel-Baender, log10
 * (identisch zu ml/clap/features.py). Ein Pegelanstieg startet einen Kandidaten; 24 Rahmen spaeter wird das
 * 32x32-Fenster pegelnormiert, int8-quantisiert und per Message-Queue an den Modell-Thread gegeben. Mehrere
 * Kandidaten duerfen sich ueberlappen (zweiter Klatscher waehrend das Fenster des ersten noch laeuft).
 * Modell-Thread (niedrigere Prioritaet): Inferenz (TensorFlow Lite Micro, ca. 53 ms), waehrenddessen liest der
 * Audio-Thread weiter, es geht kein Audio verloren. Zwei vom Modell bestaetigte Klatscher im Abstand von
 * DOUBLE_MIN_MS bis DOUBLE_MAX_MS schalten das Licht um; ein einzelner wird nach Ablauf verworfen.
 * Konsole: "MODELL other=.. clap=.. snap=.. -> clap  Inferenz x ms",
 *          "KLATSCH #n  einzel  Konfidenz 0.72", "KLATSCH #n  doppel  Abstand 310 ms  Konfidenz 0.80  LED1 an",
 *          "VERWORFEN einzel  Grund: kein zweiter Klatscher innerhalb 800 ms", "L,<max>,<floor>".
 */
#include <zephyr/kernel.h>
#include <zephyr/drivers/gpio.h>
#include <zephyr/sys/printk.h>
#include <math.h>
#include <string.h>
#ifndef M_PI
#define M_PI 3.14159265358979323846
#endif
#include "mic.h"
#include "house.h"
#include "model_data.h"
#include "features_config.h"
#include "tensorflow/lite/micro/micro_mutable_op_resolver.h"
#include "tensorflow/lite/micro/micro_interpreter.h"
#include "tensorflow/lite/schema/schema_generated.h"

#define ONSET_RATIO      6.0f
#define SUDDEN_FACTOR    3.0f
#define MIN_RMS          (300.0f / 32768.0f)
#define FLOOR_ALPHA      0.02f
#define ONSET_GAP_MS     100      /* Mindestabstand zweier Kandidaten (Abklingen desselben Klatschers nicht neu zaehlen) */
#define CLAP_THRESHOLD   0.35f
#define DOUBLE_MIN_MS    120      /* zwei Klatscher naeher zusammen: unplausibel */
#define DOUBLE_MAX_MS    800      /* zweiter Klatscher spaeter: der erste verfaellt */
#define MAX_PENDING      4

/* Auftrag an den Modell-Thread: fertig quantisiertes Fenster plus Zeit des Einsatzes */
struct infer_job { int64_t onsetMs; float onsetRms; int8_t in[FEAT_N_FRAMES * FEAT_N_BANDS]; };
K_MSGQ_DEFINE(job_q, sizeof(struct infer_job), 4, 4);

extern "C" void DebugLog(const char *s) { printk("%s", s); }   /* TFLM-Logausgabe */


/* ---------- FFT 256 ---------- */
static float twr[FEAT_FRAME / 2], twi[FEAT_FRAME / 2], hann[FEAT_FRAME], fr[FEAT_FRAME], fi[FEAT_FRAME];
static uint16_t bitrev[FEAT_FRAME];
static void fft_init() {
	for (int i = 0; i < FEAT_FRAME / 2; i++) { twr[i] = cosf(-2.0f * (float)M_PI * i / FEAT_FRAME); twi[i] = sinf(-2.0f * (float)M_PI * i / FEAT_FRAME); }
	for (int i = 0; i < FEAT_FRAME; i++) hann[i] = 0.5f - 0.5f * cosf(2.0f * (float)M_PI * i / FEAT_FRAME);
	int bits = 0; while ((1 << bits) < FEAT_FRAME) bits++;
	for (int i = 0; i < FEAT_FRAME; i++) { int r = 0; for (int b = 0; b < bits; b++) if (i & (1 << b)) r |= 1 << (bits - 1 - b); bitrev[i] = r; }
}
static void fft256() {
	for (int i = 0; i < FEAT_FRAME; i++) if (bitrev[i] > i) { float t = fr[i]; fr[i] = fr[bitrev[i]]; fr[bitrev[i]] = t; t = fi[i]; fi[i] = fi[bitrev[i]]; fi[bitrev[i]] = t; }
	for (int len = 2; len <= FEAT_FRAME; len <<= 1) {
		int half = len >> 1, step = FEAT_FRAME / len;
		for (int i = 0; i < FEAT_FRAME; i += len) for (int j = 0; j < half; j++) {
			float wr = twr[j * step], wi = twi[j * step], xr = fr[i + j + half], xi = fi[i + j + half];
			float tr = xr * wr - xi * wi, ti = xr * wi + xi * wr;
			fr[i + j + half] = fr[i + j] - tr; fi[i + j + half] = fi[i + j] - ti; fr[i + j] += tr; fi[i + j] += ti;
		}
	}
}

/* ---------- Merkmale ---------- */
static float logbands[FEAT_N_FRAMES][FEAT_N_BANDS];
static int ringHead = 0; static uint32_t frameCount = 0;
static float frame_features(const int16_t *s, float *bands) {
	float mean = 0; for (int i = 0; i < FEAT_FRAME; i++) mean += s[i]; mean /= FEAT_FRAME;
	float acc = 0;
	for (int i = 0; i < FEAT_FRAME; i++) { float v = (s[i] - mean) / 32768.0f; acc += v * v; fr[i] = v * hann[i]; fi[i] = 0.0f; }
	fft256();
	for (int b = 0; b < FEAT_N_BANDS; b++) { float e = 0; for (int k = FEAT_BAND_EDGES[b]; k < FEAT_BAND_EDGES[b + 1]; k++) e += fr[k] * fr[k] + fi[k] * fi[k]; bands[b] = log10f(e + FEAT_EPS); }
	return sqrtf(acc / FEAT_FRAME);
}

/* ---------- TFLM ---------- */
namespace {
constexpr int kArenaSize = 40 * 1024;
alignas(16) uint8_t arena[kArenaSize];
tflite::MicroMutableOpResolver<8> resolver;
tflite::MicroInterpreter *interp = nullptr;
alignas(tflite::MicroInterpreter) uint8_t interpMem[sizeof(tflite::MicroInterpreter)];
TfLiteTensor *inT = nullptr, *outT = nullptr;
}
static bool model_init() {
	const tflite::Model *model = tflite::GetModel(g_clap_model);
	if (model->version() != TFLITE_SCHEMA_VERSION) return false;
	resolver.AddConv2D(); resolver.AddMaxPool2D(); resolver.AddReshape(); resolver.AddFullyConnected();
	resolver.AddSoftmax(); resolver.AddQuantize(); resolver.AddDequantize(); resolver.AddMean();
	interp = new (interpMem) tflite::MicroInterpreter(model, resolver, arena, kArenaSize);
	if (interp->AllocateTensors() != kTfLiteOk) return false;
	inT = interp->input(0); outT = interp->output(0);
	return inT && outT && inT->type == kTfLiteInt8 && outT->type == kTfLiteInt8;
}
/* Audio-Thread: Fenster um den Einsatz pegelnormieren und quantisieren (wie ml/clap/features.py) */
static void quantize_window(int onsetIdx, int8_t *q) {
	float mx = -1e9f;
	for (int f = 0; f < FEAT_N_FRAMES; f++) { int r = (onsetIdx - FEAT_ONSET_FRAME + f + FEAT_N_FRAMES) % FEAT_N_FRAMES; for (int b = 0; b < FEAT_N_BANDS; b++) if (logbands[r][b] > mx) mx = logbands[r][b]; }
	for (int f = 0; f < FEAT_N_FRAMES; f++) { int r = (onsetIdx - FEAT_ONSET_FRAME + f + FEAT_N_FRAMES) % FEAT_N_FRAMES;
		for (int b = 0; b < FEAT_N_BANDS; b++) { float v = (logbands[r][b] - mx + FEAT_DYN_RANGE) / FEAT_DYN_RANGE; if (v < 0) v = 0; if (v > 1) v = 1;
			int qi = (int)lroundf(v / MODEL_IN_SCALE) + MODEL_IN_ZERO; if (qi < -128) qi = -128; if (qi > 127) qi = 127; q[f * FEAT_N_BANDS + b] = (int8_t)qi; } }
}
/* Modell-Thread: Inferenz auf einem fertigen Fenster */
static bool model_run(const int8_t *in, float *probs, int64_t *usec) {
	memcpy(inT->data.int8, in, FEAT_N_FRAMES * FEAT_N_BANDS);
	int64_t t0 = k_uptime_ticks();
	if (interp->Invoke() != kTfLiteOk) return false;
	*usec = k_ticks_to_us_floor64(k_uptime_ticks() - t0);
	for (int c = 0; c < 3; c++) probs[c] = (outT->data.int8[c] - MODEL_OUT_ZERO) * MODEL_OUT_SCALE;
	return true;
}

/* ---------- Audio-Thread: Rahmen, Einsaetze, Kandidaten ---------- */
static int16_t pcm[FEAT_FRAME]; static size_t fill = 0;
static float noiseFloor = 0.02f, prevRms = 0.0f, windowMax = 0.0f;
struct candidate { int onsetIdx, wait; int64_t onsetMs; float rms; };
static struct candidate pend[MAX_PENDING]; static int nPend = 0;
static int64_t lastOnsetMs = 0, lastLevelMs = 0; static uint32_t dropped = 0;

static void process_frame() {
	float rms = frame_features(pcm, logbands[ringHead]);
	int idx = ringHead; ringHead = (ringHead + 1) % FEAT_N_FRAMES; frameCount++;
	int64_t now = k_uptime_get(); float ratio = rms / noiseFloor;
	if (ratio < ONSET_RATIO) noiseFloor += FLOOR_ALPHA * (rms - noiseFloor);
	if (noiseFloor < 50.0f / 32768.0f) noiseFloor = 50.0f / 32768.0f;
	bool loud = ratio >= ONSET_RATIO && rms >= MIN_RMS, sudden = prevRms * SUDDEN_FACTOR <= rms, gap = now - lastOnsetMs >= ONSET_GAP_MS;
	if (loud && sudden && gap && frameCount >= (uint32_t)FEAT_N_FRAMES && nPend < MAX_PENDING) {
		pend[nPend++] = (struct candidate){ idx, FEAT_N_FRAMES - FEAT_ONSET_FRAME - 1, now, rms }; lastOnsetMs = now;
	}
	/* fertige Fenster an den Modell-Thread geben (aeltester Kandidat zuerst) */
	for (int i = 0; i < nPend; ) {
		if (--pend[i].wait > 0) { i++; continue; }
		struct infer_job job; job.onsetMs = pend[i].onsetMs; job.onsetRms = pend[i].rms; quantize_window(pend[i].onsetIdx, job.in);
		if (k_msgq_put(&job_q, &job, K_NO_WAIT) != 0) dropped++;
		for (int j = i + 1; j < nPend; j++) pend[j - 1] = pend[j];
		nPend--;
	}
	prevRms = rms;
	if (rms > windowMax) windowMax = rms;
	if (now - lastLevelMs >= 100) { lastLevelMs = now; printk("L,%d,%d\n", (int)(windowMax * 32768.0f), (int)(noiseFloor * 32768.0f)); windowMax = 0; }
}

/* ---------- Modell-Thread: Inferenz und Doppelklatsch-Logik ---------- */
static uint32_t claps = 0; static bool led1on = false;
static int64_t firstMs = 0;        /* Einsatz des ersten bestaetigten Klatschers, 0 = keiner offen */

static void model_thread(void *a, void *b, void *c) {
	(void)a; (void)b; (void)c;
	struct infer_job job;
	for (;;) {
		if (k_msgq_get(&job_q, &job, K_MSEC(50)) != 0) {
			/* kein Auftrag: offenen ersten Klatscher verfallen lassen (Ergebnis des zweiten kaeme spaetestens ~450 ms nach seinem Einsatz) */
			if (firstMs && k_uptime_get() - firstMs > DOUBLE_MAX_MS + 500) { firstMs = 0; printk("VERWORFEN einzel  Grund: kein zweiter Klatscher innerhalb %d ms\n", DOUBLE_MAX_MS); }
			continue;
		}
		float p[3]; int64_t us = 0;
		if (!model_run(job.in, p, &us)) continue;
		int best = 0; for (int k = 1; k < 3; k++) if (p[k] > p[best]) best = k;
		printk("MODELL %s=%.2f %s=%.2f %s=%.2f -> %s  Inferenz %.1f ms\n", MODEL_CLASSES[0], (double)p[0], MODEL_CLASSES[1], (double)p[1], MODEL_CLASSES[2], (double)p[2], MODEL_CLASSES[best], (double)us / 1000.0);
		if (p[1] < CLAP_THRESHOLD) continue;
		claps++;
		int64_t gap = firstMs ? job.onsetMs - firstMs : 0;
		if (firstMs && gap >= DOUBLE_MIN_MS && gap <= DOUBLE_MAX_MS) {
			firstMs = 0; led1on = house_toggle_light();
			printk("KLATSCH #%u  doppel  Abstand %d ms  Konfidenz %.2f  LED1 %s\n", claps, (int)gap, (double)p[1], led1on ? "an" : "aus");
		} else {
			if (firstMs) printk("VERWORFEN einzel  Grund: Abstand %d ms ausserhalb %d..%d ms\n", (int)gap, DOUBLE_MIN_MS, DOUBLE_MAX_MS);
			firstMs = job.onsetMs;
			printk("KLATSCH #%u  einzel  Konfidenz %.2f\n", claps, (double)p[1]);
		}
	}
}
K_THREAD_STACK_DEFINE(model_stack, 8192);
static struct k_thread model_td;

void clap_thread(void *a, void *b, void *c) {
	(void)a; (void)b; (void)c;
	printk("AUDIO: Klatsch-Modell (TensorFlow Lite Micro)\n");
	fft_init();
	if (!model_init()) { printk("FEHLER: Modell\n"); for (;;) { k_msleep(100); } }
	printk("Modell geladen, Arena %u Bytes, Eingabe %u Bytes\n", (unsigned)interp->arena_used_bytes(), (unsigned)inT->bytes);
	if (mic_init()) { printk("FEHLER: Mikrofon\n"); for (;;) { k_msleep(200); } }
	printk("Mikrofon laeuft: 16 kHz mono, 16-ms-Rahmen, 32 Baender\n");
	printk("Doppelklatschen: zwei Klatscher im Abstand %d..%d ms schalten das Licht\n", DOUBLE_MIN_MS, DOUBLE_MAX_MS);
	/* Modell-Thread eine Stufe unter dem Audio-Thread: die Inferenz (ca. 53 ms) unterbricht das Lesen nicht */
	k_thread_create(&model_td, model_stack, K_THREAD_STACK_SIZEOF(model_stack), model_thread, NULL, NULL, NULL, 6, 0, K_NO_WAIT);
	k_thread_name_set(&model_td, "model");
	int16_t tmp[256]; int64_t lastDiag = 0;
	for (;;) {
		size_t n = mic_read(tmp, 256);
		for (size_t i = 0; i < n; i++) { pcm[fill++] = tmp[i]; if (fill == FEAT_FRAME) { process_frame(); fill = 0; } }
		if (n == 0) k_msleep(2);
		int64_t now = k_uptime_get();
		if (dropped && now - lastDiag > 5000) { lastDiag = now; printk("WARNUNG: %u Fenster verworfen (Modell-Warteschlange voll)\n", dropped); }
	}
}
```

## src/house.h
```c
/* Hauslogik: verbindet Anwesenheit (Bluetooth) und Klatschen (Audio) zu einem Lichtschalter.
 *   LED1 = Licht (per Klatschen umschaltbar, geht aus, wenn das Handy das Haus verlaesst)
 *   LED2 = Anwesenheit (an, solange das Handy erreichbar ist) */
#ifndef HOUSE_H
#define HOUSE_H
#include <stdbool.h>
#ifdef __cplusplus
extern "C" {
#endif
void house_init(void);
void house_set_presence(bool present);   /* vom Bluetooth-Thread */
bool house_toggle_light(void);           /* vom Audio-Thread bei Klatschen; liefert neuen Lichtzustand */
bool house_light(void);
bool house_present(void);
void bt_presence_thread(void *a, void *b, void *c);
void clap_thread(void *a, void *b, void *c);
#ifdef __cplusplus
}
#endif
#endif
```

## src/mic.c
```c
#include "mic.h"
#include <zephyr/kernel.h>
#include <zephyr/sys/printk.h>
#include "cyhal_clock.h"
#include "cyhal_pdmpcm.h"
#include "cyhal_hw_types.h"
#include "cy_sysclk.h"
#include "cy_pdm_pcm.h"

/* Pins laut Infineon-BSP: PDM_CLK P10.4, PDM_DATA P10.5 */
#define MIC_PIN_CLK   P10_4
#define MIC_PIN_DATA  P10_5
#define AUDIO_SYS_CLOCK_HZ 24576000u     /* wie in Infineons Arduino-PDM-Bibliothek */

static cyhal_clock_t pll_clock, audio_clock;
static cyhal_pdm_pcm_t pdm;
static uint32_t overflows;

int mic_init(void)
{
	cy_rslt_t r;
	/* Takt: PLL0 auf 24,576 MHz, HF1 (Audio-Subsystem) daraus speisen. Zephyr nutzt die FLL fuer HF0, PLL0 ist frei.
	 * Die PLL0 haengt an Taktpfad 1; dessen Quelle muss der IMO (8 MHz) sein. Unter ModusToolbox macht das die
	 * Board-Initialisierung, unter Zephyr setzen wir es selbst. */
	Cy_SysClk_ClkPathSetSource(1, CY_SYSCLK_CLKPATH_IN_IMO);
	printk("mic: Pfad1-Quelle %d, Pfad1 %u Hz vor PLL\n", (int)Cy_SysClk_ClkPathGetSource(1), (unsigned)Cy_SysClk_ClkPathMuxGetFrequency(1));
	r = cyhal_clock_reserve(&pll_clock, &CYHAL_CLOCK_PLL[0]);
	if (r != CY_RSLT_SUCCESS) { printk("mic: PLL reserve 0x%08x\n", (unsigned)r); return -1; }
	r = cyhal_clock_set_frequency(&pll_clock, AUDIO_SYS_CLOCK_HZ, NULL);
	if (r != CY_RSLT_SUCCESS) { printk("mic: PLL freq 0x%08x\n", (unsigned)r); return -2; }
	r = cyhal_clock_set_enabled(&pll_clock, true, true);
	if (r != CY_RSLT_SUCCESS) { printk("mic: PLL enable 0x%08x\n", (unsigned)r); return -3; }
	r = cyhal_clock_reserve(&audio_clock, &CYHAL_CLOCK_HF[1]);
	if (r != CY_RSLT_SUCCESS) { printk("mic: HF1 reserve 0x%08x\n", (unsigned)r); return -4; }
	r = cyhal_clock_set_source(&audio_clock, &pll_clock);
	if (r != CY_RSLT_SUCCESS) { printk("mic: HF1 source 0x%08x\n", (unsigned)r); return -5; }
	r = cyhal_clock_set_enabled(&audio_clock, true, true);
	if (r != CY_RSLT_SUCCESS) { printk("mic: HF1 enable 0x%08x\n", (unsigned)r); return -6; }
	printk("mic: PLL0 %u Hz, HF1 %u Hz\n", (unsigned)cyhal_clock_get_frequency(&pll_clock), (unsigned)cyhal_clock_get_frequency(&audio_clock));

	const cyhal_pdm_pcm_cfg_t cfg = {
		.sample_rate = MIC_RATE,
		.decimation_rate = 64,
		.mode = CYHAL_PDM_PCM_MODE_LEFT,
		.word_length = 16,
		.left_gain = 20,
		.right_gain = 20,
	};
	r = cyhal_pdm_pcm_init(&pdm, MIC_PIN_DATA, MIC_PIN_CLK, &audio_clock, &cfg);
	if (r != CY_RSLT_SUCCESS) { printk("mic: pdm init 0x%08x\n", (unsigned)r); return -7; }
	r = cyhal_pdm_pcm_start(&pdm);
	if (r != CY_RSLT_SUCCESS) { printk("mic: pdm start 0x%08x\n", (unsigned)r); return -8; }
	k_msleep(50);
	printk("mic: FIFO nach 50 ms: %u Woerter, Interrupt-Status 0x%08x\n", (unsigned)Cy_PDM_PCM_GetNumInFifo(PDM0), (unsigned)Cy_PDM_PCM_GetInterruptStatus(PDM0));
	return 0;
}

size_t mic_read(int16_t *dst, size_t max_samples)
{
	/* Bei word_length 16 schreibt die HAL 16-Bit-Samples (uint16_t) direkt in den Puffer. Ein 32-Bit-Zwischenpuffer
	 * (frueherer Fehler) lieferte nur jedes zweite Sample plus alte Reste: Grundrauschen um 800 statt 50. */
	size_t n = max_samples < 256 ? max_samples : 256;
	if (cyhal_pdm_pcm_read(&pdm, dst, &n) != CY_RSLT_SUCCESS) return 0;
	return n;
}

uint32_t mic_overflows(void) { return overflows; }
uint32_t mic_fifo_count(void) { return Cy_PDM_PCM_GetNumInFifo(PDM0); }
```
