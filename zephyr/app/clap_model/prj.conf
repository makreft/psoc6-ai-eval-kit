## CMakeLists.txt
```
cmake_minimum_required(VERSION 3.20.0)
find_package(Zephyr REQUIRED HINTS $ENV{ZEPHYR_BASE})
project(clap_model LANGUAGES C CXX)

# TensorFlow Lite Micro: Quellen aus der Arduino-Bibliothek Chirale_TensorFLowLite (reiner TFLM-Baum mit
# CMSIS-NN-Kerneln). Pfad per -DTFLM_DIR=... ueberschreibbar. Arduino-spezifische Dateien werden ausgelassen.
# TensorFlow Lite Micro: west-Modul aus zephyr/manifest/west.yml (Chirale_TensorFlowLite v2.0.0)
set(TFLM_DIR "${ZEPHYR_BASE}/../modules/lib/chirale-tflm/src" CACHE PATH "TFLM-Quellbaum")
file(GLOB_RECURSE TFLM_SRC
  ${TFLM_DIR}/tensorflow/*.cpp ${TFLM_DIR}/tensorflow/*.cc ${TFLM_DIR}/tensorflow/*.c
  ${TFLM_DIR}/third_party/cmsis_nn/Source/*.c)
list(FILTER TFLM_SRC EXCLUDE REGEX "system_setup\\.cpp$|/peripherals/|_test\\.(cpp|cc)$|/testing/|/benchmarks/|/examples/")

# Die TFLM-Quellen gehoeren direkt zum Anwendungsziel (libapp.a, whole-archive). Eine eigene
# zephyr_library_named() landete nicht in der finalen Link-Zeile.
target_sources(app PRIVATE ${TFLM_SRC})
set_source_files_properties(${TFLM_SRC} PROPERTIES COMPILE_OPTIONS
  "-Wno-unused-parameter;-Wno-sign-compare;-Wno-missing-field-initializers;-Wno-unused-variable;-Wno-deprecated-declarations;-Wno-unused-function")
# Modell und Merkmalskonfiguration direkt aus der Trainings-Pipeline (eine Quelle, keine Kopien)
zephyr_include_directories(${CMAKE_CURRENT_SOURCE_DIR}/../../../ml/clap/out)
zephyr_include_directories(
  ${TFLM_DIR}
  ${TFLM_DIR}/third_party/flatbuffers/include
  ${TFLM_DIR}/third_party/gemmlowp
  ${TFLM_DIR}/third_party/ruy
  ${TFLM_DIR}/third_party/kissfft
  ${TFLM_DIR}/third_party/cmsis_nn
  ${TFLM_DIR}/third_party/cmsis_nn/Include
  ${TFLM_DIR}/third_party/cmsis/CMSIS/Core/Include)
# ARDUINO=100: die Bibliothek ist fuer Arduino aufbereitet; mit dem Makro nimmt sie die statischen Code-Pfade
# (ohne dynamische TfLiteIntArray-Hilfen). Arduino-Header werden trotzdem nicht gebraucht, die Dateien sind ausgelassen.
zephyr_compile_definitions(TF_LITE_STATIC_MEMORY TF_LITE_STRIP_ERROR_STRINGS TF_LITE_MCU_DEBUG_LOG CMSIS_NN ARDUINO=100 ARDUINO_EXCLUDE_CODE)

set(HAL_DIR ${ZEPHYR_HAL_INFINEON_MODULE_DIR}/mtb-hal-cat1)
set(PDL_DIR ${ZEPHYR_HAL_INFINEON_MODULE_DIR}/mtb-pdl-cat1)
target_sources(app PRIVATE
  src/main.cpp
  src/mic.c
  src/cyhal_dma_stub.c
  ${HAL_DIR}/source/cyhal_pdmpcm.c
  ${HAL_DIR}/source/cyhal_audio_common.c
  ${PDL_DIR}/drivers/source/cy_pdm_pcm.c)
```

## prj.conf
```kconfig
# Klatsch-Modell unter Zephyr: Mikrofon (HAL), Merkmale in C, TensorFlow Lite Micro als Zephyr-Bibliothek
CONFIG_GPIO=y
CONFIG_SERIAL=y
CONFIG_CONSOLE=y
CONFIG_UART_CONSOLE=y
CONFIG_PRINTK=y
CONFIG_LOG=y
CONFIG_LOG_DEFAULT_LEVEL=2
CONFIG_FPU=y
CONFIG_CBPRINTF_FP_SUPPORT=y

# C++ fuer TFLM
CONFIG_CPP=y
CONFIG_STD_CPP17=y
CONFIG_GLIBCXX_LIBCPP=y
CONFIG_CPP_EXCEPTIONS=n
CONFIG_CPP_RTTI=n

CONFIG_MAIN_STACK_SIZE=16384
CONFIG_HEAP_MEM_POOL_SIZE=16384
```

## src/main.cpp
```c
/*
 * Klatschen erkennen mit dem selbst trainierten Modell, unter Zephyr (Port von arduino/sketchbook/05-clap-model).
 *
 * Mikrofon ueber die Infineon-HAL (mic.c), je 16-ms-Rahmen Hann, FFT 256, 32 Mel-Baender, log10 (identisch zu
 * ml/clap/features.py). Pegelanstieg startet einen Kandidaten; 24 Rahmen spaeter wird das 32x32-Fenster
 * pegelnormiert, int8-quantisiert und durch das Modell (TensorFlow Lite Micro) geschickt.
 * Konsole wie Sketch 05: "MODELL other=.. clap=.. snap=.. -> clap  Inferenz x ms", "KLATSCH #n ...", "L,<max>,<floor>".
 */
#include <zephyr/kernel.h>
#include <zephyr/drivers/gpio.h>
#include <zephyr/sys/printk.h>
#include <math.h>
#include <string.h>
#ifndef M_PI
#define M_PI 3.14159265358979323846
#endif
#include "mic.h"
#include "model_data.h"
#include "features_config.h"
#include "tensorflow/lite/micro/micro_mutable_op_resolver.h"
#include "tensorflow/lite/micro/micro_interpreter.h"
#include "tensorflow/lite/schema/schema_generated.h"

#define ONSET_RATIO      6.0f
#define SUDDEN_FACTOR    3.0f
#define MIN_RMS          (300.0f / 32768.0f)
#define FLOOR_ALPHA      0.02f
#define REFRACTORY_MS    400
#define CLAP_THRESHOLD   0.35f

extern "C" void DebugLog(const char *s) { printk("%s", s); }   /* TFLM-Logausgabe */

static const struct gpio_dt_spec led1 = GPIO_DT_SPEC_GET(DT_ALIAS(led0), gpios);
static const struct gpio_dt_spec led2 = GPIO_DT_SPEC_GET(DT_NODELABEL(user_led1), gpios);

/* ---------- FFT 256 ---------- */
static float twr[FEAT_FRAME / 2], twi[FEAT_FRAME / 2], hann[FEAT_FRAME], fr[FEAT_FRAME], fi[FEAT_FRAME];
static uint16_t bitrev[FEAT_FRAME];
static void fft_init() {
	for (int i = 0; i < FEAT_FRAME / 2; i++) { twr[i] = cosf(-2.0f * (float)M_PI * i / FEAT_FRAME); twi[i] = sinf(-2.0f * (float)M_PI * i / FEAT_FRAME); }
	for (int i = 0; i < FEAT_FRAME; i++) hann[i] = 0.5f - 0.5f * cosf(2.0f * (float)M_PI * i / FEAT_FRAME);
	int bits = 0; while ((1 << bits) < FEAT_FRAME) bits++;
	for (int i = 0; i < FEAT_FRAME; i++) { int r = 0; for (int b = 0; b < bits; b++) if (i & (1 << b)) r |= 1 << (bits - 1 - b); bitrev[i] = r; }
}
static void fft256() {
	for (int i = 0; i < FEAT_FRAME; i++) if (bitrev[i] > i) { float t = fr[i]; fr[i] = fr[bitrev[i]]; fr[bitrev[i]] = t; t = fi[i]; fi[i] = fi[bitrev[i]]; fi[bitrev[i]] = t; }
	for (int len = 2; len <= FEAT_FRAME; len <<= 1) {
		int half = len >> 1, step = FEAT_FRAME / len;
		for (int i = 0; i < FEAT_FRAME; i += len) for (int j = 0; j < half; j++) {
			float wr = twr[j * step], wi = twi[j * step], xr = fr[i + j + half], xi = fi[i + j + half];
			float tr = xr * wr - xi * wi, ti = xr * wi + xi * wr;
			fr[i + j + half] = fr[i + j] - tr; fi[i + j + half] = fi[i + j] - ti; fr[i + j] += tr; fi[i + j] += ti;
		}
	}
}

/* ---------- Merkmale ---------- */
static float logbands[FEAT_N_FRAMES][FEAT_N_BANDS];
static int ringHead = 0; static uint32_t frameCount = 0;
static float frame_features(const int16_t *s, float *bands) {
	float mean = 0; for (int i = 0; i < FEAT_FRAME; i++) mean += s[i]; mean /= FEAT_FRAME;
	float acc = 0;
	for (int i = 0; i < FEAT_FRAME; i++) { float v = (s[i] - mean) / 32768.0f; acc += v * v; fr[i] = v * hann[i]; fi[i] = 0.0f; }
	fft256();
	for (int b = 0; b < FEAT_N_BANDS; b++) { float e = 0; for (int k = FEAT_BAND_EDGES[b]; k < FEAT_BAND_EDGES[b + 1]; k++) e += fr[k] * fr[k] + fi[k] * fi[k]; bands[b] = log10f(e + FEAT_EPS); }
	return sqrtf(acc / FEAT_FRAME);
}

/* ---------- TFLM ---------- */
namespace {
constexpr int kArenaSize = 40 * 1024;
alignas(16) uint8_t arena[kArenaSize];
tflite::MicroMutableOpResolver<8> resolver;
tflite::MicroInterpreter *interp = nullptr;
alignas(tflite::MicroInterpreter) uint8_t interpMem[sizeof(tflite::MicroInterpreter)];
TfLiteTensor *inT = nullptr, *outT = nullptr;
}
static bool model_init() {
	const tflite::Model *model = tflite::GetModel(g_clap_model);
	if (model->version() != TFLITE_SCHEMA_VERSION) return false;
	resolver.AddConv2D(); resolver.AddMaxPool2D(); resolver.AddReshape(); resolver.AddFullyConnected();
	resolver.AddSoftmax(); resolver.AddQuantize(); resolver.AddDequantize(); resolver.AddMean();
	interp = new (interpMem) tflite::MicroInterpreter(model, resolver, arena, kArenaSize);
	if (interp->AllocateTensors() != kTfLiteOk) return false;
	inT = interp->input(0); outT = interp->output(0);
	return inT && outT && inT->type == kTfLiteInt8 && outT->type == kTfLiteInt8;
}
static bool model_run(int onsetIdx, float *probs, int64_t *usec) {
	float mx = -1e9f;
	for (int f = 0; f < FEAT_N_FRAMES; f++) { int r = (onsetIdx - FEAT_ONSET_FRAME + f + FEAT_N_FRAMES) % FEAT_N_FRAMES; for (int b = 0; b < FEAT_N_BANDS; b++) if (logbands[r][b] > mx) mx = logbands[r][b]; }
	int8_t *q = inT->data.int8;
	for (int f = 0; f < FEAT_N_FRAMES; f++) { int r = (onsetIdx - FEAT_ONSET_FRAME + f + FEAT_N_FRAMES) % FEAT_N_FRAMES;
		for (int b = 0; b < FEAT_N_BANDS; b++) { float v = (logbands[r][b] - mx + FEAT_DYN_RANGE) / FEAT_DYN_RANGE; if (v < 0) v = 0; if (v > 1) v = 1;
			int qi = (int)lroundf(v / MODEL_IN_SCALE) + MODEL_IN_ZERO; if (qi < -128) qi = -128; if (qi > 127) qi = 127; q[f * FEAT_N_BANDS + b] = (int8_t)qi; } }
	int64_t t0 = k_uptime_ticks();
	if (interp->Invoke() != kTfLiteOk) return false;
	*usec = k_ticks_to_us_floor64(k_uptime_ticks() - t0);
	for (int c = 0; c < 3; c++) probs[c] = (outT->data.int8[c] - MODEL_OUT_ZERO) * MODEL_OUT_SCALE;
	return true;
}

/* ---------- Ablauf ---------- */
static int16_t pcm[FEAT_FRAME]; static size_t fill = 0;
static float noiseFloor = 0.02f, prevRms = 0.0f, windowMax = 0.0f;
static bool pending = false; static int pendingOnset = 0, pendingWait = 0;
static int64_t lastClapMs = 0, led2OffMs = 0, lastLevelMs = 0; static uint32_t claps = 0; static bool led1on = false;

static void process_frame() {
	float rms = frame_features(pcm, logbands[ringHead]);
	int idx = ringHead; ringHead = (ringHead + 1) % FEAT_N_FRAMES; frameCount++;
	int64_t now = k_uptime_get(); float ratio = rms / noiseFloor;
	if (!pending) {
		if (ratio < ONSET_RATIO) noiseFloor += FLOOR_ALPHA * (rms - noiseFloor);
		if (noiseFloor < 50.0f / 32768.0f) noiseFloor = 50.0f / 32768.0f;
		bool loud = ratio >= ONSET_RATIO && rms >= MIN_RMS, sudden = prevRms * SUDDEN_FACTOR <= rms, fr_ = now - lastClapMs >= REFRACTORY_MS;
		if (loud && sudden && fr_ && frameCount >= (uint32_t)FEAT_N_FRAMES) { pending = true; pendingOnset = idx; pendingWait = FEAT_N_FRAMES - FEAT_ONSET_FRAME - 1; }
	} else if (--pendingWait <= 0) {
		pending = false; float p[3]; int64_t us = 0;
		if (model_run(pendingOnset, p, &us)) {
			int best = 0; for (int c = 1; c < 3; c++) if (p[c] > p[best]) best = c;
			printk("MODELL %s=%.2f %s=%.2f %s=%.2f -> %s  Inferenz %.1f ms\n", MODEL_CLASSES[0], (double)p[0], MODEL_CLASSES[1], (double)p[1], MODEL_CLASSES[2], (double)p[2], MODEL_CLASSES[best], (double)us / 1000.0);
			if (p[1] >= CLAP_THRESHOLD) {
				claps++; lastClapMs = now; led1on = !led1on; gpio_pin_set_dt(&led1, led1on); gpio_pin_set_dt(&led2, 1); led2OffMs = now + 80;
				printk("KLATSCH #%u  Dauer 0 ms  Peak 0  x%d  LED1 %s\n", claps, (int)(p[1] * 100), led1on ? "an" : "aus");
			}
		}
	}
	prevRms = rms;
	if (rms > windowMax) windowMax = rms;
	if (now - lastLevelMs >= 100) { lastLevelMs = now; printk("L,%d,%d\n", (int)(windowMax * 32768.0f), (int)(noiseFloor * 32768.0f)); windowMax = 0; }
}

int main(void) {
	gpio_pin_configure_dt(&led1, GPIO_OUTPUT_INACTIVE); gpio_pin_configure_dt(&led2, GPIO_OUTPUT_INACTIVE);
	printk("\nKlatsch-Modell (TensorFlow Lite Micro) unter Zephyr\n");
	fft_init();
	if (!model_init()) { printk("FEHLER: Modell\n"); for (;;) { gpio_pin_toggle_dt(&led2); k_msleep(100); } }
	printk("Modell geladen, Arena %u Bytes, Eingabe %u Bytes\n", (unsigned)interp->arena_used_bytes(), (unsigned)inT->bytes);
	if (mic_init()) { printk("FEHLER: Mikrofon\n"); for (;;) { gpio_pin_toggle_dt(&led2); k_msleep(200); } }
	printk("Mikrofon laeuft: 16 kHz mono, 16-ms-Rahmen, 32 Baender\n");
	int16_t tmp[256];
	for (;;) {
		if (led2OffMs && k_uptime_get() >= led2OffMs) { gpio_pin_set_dt(&led2, 0); led2OffMs = 0; }
		size_t n = mic_read(tmp, 256);
		for (size_t i = 0; i < n; i++) { pcm[fill++] = tmp[i]; if (fill == FEAT_FRAME) { process_frame(); fill = 0; } }
		if (n == 0) k_msleep(2);
	}
	return 0;
}
```

## src/mic.c
```c
#include "mic.h"
#include <zephyr/kernel.h>
#include <zephyr/sys/printk.h>
#include "cyhal_clock.h"
#include "cyhal_pdmpcm.h"
#include "cyhal_hw_types.h"
#include "cy_sysclk.h"
#include "cy_pdm_pcm.h"

/* Pins laut Infineon-BSP: PDM_CLK P10.4, PDM_DATA P10.5 */
#define MIC_PIN_CLK   P10_4
#define MIC_PIN_DATA  P10_5
#define AUDIO_SYS_CLOCK_HZ 24576000u     /* wie in Infineons Arduino-PDM-Bibliothek */

static cyhal_clock_t pll_clock, audio_clock;
static cyhal_pdm_pcm_t pdm;
static int32_t fifo_buf[256];
static uint32_t overflows;

int mic_init(void)
{
	cy_rslt_t r;
	/* Takt: PLL0 auf 24,576 MHz, HF1 (Audio-Subsystem) daraus speisen. Zephyr nutzt die FLL fuer HF0, PLL0 ist frei.
	 * Die PLL0 haengt an Taktpfad 1; dessen Quelle muss der IMO (8 MHz) sein. Unter ModusToolbox macht das die
	 * Board-Initialisierung, unter Zephyr setzen wir es selbst. */
	Cy_SysClk_ClkPathSetSource(1, CY_SYSCLK_CLKPATH_IN_IMO);
	printk("mic: Pfad1-Quelle %d, Pfad1 %u Hz vor PLL\n", (int)Cy_SysClk_ClkPathGetSource(1), (unsigned)Cy_SysClk_ClkPathMuxGetFrequency(1));
	r = cyhal_clock_reserve(&pll_clock, &CYHAL_CLOCK_PLL[0]);
	if (r != CY_RSLT_SUCCESS) { printk("mic: PLL reserve 0x%08x\n", (unsigned)r); return -1; }
	r = cyhal_clock_set_frequency(&pll_clock, AUDIO_SYS_CLOCK_HZ, NULL);
	if (r != CY_RSLT_SUCCESS) { printk("mic: PLL freq 0x%08x\n", (unsigned)r); return -2; }
	r = cyhal_clock_set_enabled(&pll_clock, true, true);
	if (r != CY_RSLT_SUCCESS) { printk("mic: PLL enable 0x%08x\n", (unsigned)r); return -3; }
	r = cyhal_clock_reserve(&audio_clock, &CYHAL_CLOCK_HF[1]);
	if (r != CY_RSLT_SUCCESS) { printk("mic: HF1 reserve 0x%08x\n", (unsigned)r); return -4; }
	r = cyhal_clock_set_source(&audio_clock, &pll_clock);
	if (r != CY_RSLT_SUCCESS) { printk("mic: HF1 source 0x%08x\n", (unsigned)r); return -5; }
	r = cyhal_clock_set_enabled(&audio_clock, true, true);
	if (r != CY_RSLT_SUCCESS) { printk("mic: HF1 enable 0x%08x\n", (unsigned)r); return -6; }
	printk("mic: PLL0 %u Hz, HF1 %u Hz\n", (unsigned)cyhal_clock_get_frequency(&pll_clock), (unsigned)cyhal_clock_get_frequency(&audio_clock));

	const cyhal_pdm_pcm_cfg_t cfg = {
		.sample_rate = MIC_RATE,
		.decimation_rate = 64,
		.mode = CYHAL_PDM_PCM_MODE_LEFT,
		.word_length = 16,
		.left_gain = 20,
		.right_gain = 20,
	};
	r = cyhal_pdm_pcm_init(&pdm, MIC_PIN_DATA, MIC_PIN_CLK, &audio_clock, &cfg);
	if (r != CY_RSLT_SUCCESS) { printk("mic: pdm init 0x%08x\n", (unsigned)r); return -7; }
	r = cyhal_pdm_pcm_start(&pdm);
	if (r != CY_RSLT_SUCCESS) { printk("mic: pdm start 0x%08x\n", (unsigned)r); return -8; }
	k_msleep(50);
	printk("mic: FIFO nach 50 ms: %u Woerter, Interrupt-Status 0x%08x\n", (unsigned)Cy_PDM_PCM_GetNumInFifo(PDM0), (unsigned)Cy_PDM_PCM_GetInterruptStatus(PDM0));
	return 0;
}

size_t mic_read(int16_t *dst, size_t max_samples)
{
	size_t n = max_samples < 256 ? max_samples : 256;
	if (cyhal_pdm_pcm_read(&pdm, fifo_buf, &n) != CY_RSLT_SUCCESS) return 0;
	for (size_t i = 0; i < n; i++) dst[i] = (int16_t)fifo_buf[i];
	return n;
}

uint32_t mic_overflows(void) { return overflows; }
uint32_t mic_fifo_count(void) { return Cy_PDM_PCM_GetNumInFifo(PDM0); }
```

## src/mic.h
```c
/* PDM-Mikrofon des CY8CKIT-062S2-AI ueber die Infineon-HAL, 16 kHz mono, 16 Bit. */
#ifndef MIC_H
#define MIC_H
#include <stdint.h>
#include <stddef.h>
#ifdef __cplusplus
extern "C" {
#endif

#define MIC_RATE 16000

int mic_init(void);                               /* Audio-Takt (PLL0 24,576 MHz -> HF1) und PDM/PCM starten */
size_t mic_read(int16_t *dst, size_t max_samples);  /* so viele Samples wie im FIFO liegen, bis max */
uint32_t mic_overflows(void);
uint32_t mic_fifo_count(void);
#ifdef __cplusplus
}
#endif
#endif
```
