## CMakeLists.txt
```
cmake_minimum_required(VERSION 3.20.0)
find_package(Zephyr REQUIRED HINTS $ENV{ZEPHYR_BASE})
project(clap_rules)

# Mikrofon ueber die Infineon-HAL (PDM/PCM). Zephyr baut diese HAL-Teile fuer CAT1A nicht selbst,
# deshalb werden sie hier als Anwendungsquellen hinzugefuegt (Pfade siehe Protokoll Abschnitt 60).
set(HAL_DIR ${ZEPHYR_HAL_INFINEON_MODULE_DIR}/mtb-hal-cat1)
set(PDL_DIR ${ZEPHYR_HAL_INFINEON_MODULE_DIR}/mtb-pdl-cat1)
target_sources(app PRIVATE
  src/main.c
  src/mic.c
  src/cyhal_dma_stub.c
  ${HAL_DIR}/source/cyhal_pdmpcm.c
  ${HAL_DIR}/source/cyhal_audio_common.c
  ${PDL_DIR}/drivers/source/cy_pdm_pcm.c
)
```

## prj.conf
```kconfig
# Mikrofon-Test unter Zephyr: regelbasierter Klatsch-Detektor (Port von arduino/sketchbook/03-clap-led)
CONFIG_GPIO=y
CONFIG_SERIAL=y
CONFIG_CONSOLE=y
CONFIG_UART_CONSOLE=y
CONFIG_PRINTK=y
CONFIG_LOG=y
CONFIG_LOG_DEFAULT_LEVEL=2
CONFIG_MAIN_STACK_SIZE=4096
CONFIG_HEAP_MEM_POOL_SIZE=8192
CONFIG_FPU=y
CONFIG_CBPRINTF_FP_SUPPORT=y
```

## src/main.c
```c
/*
 * Regelbasierter Klatsch-Detektor unter Zephyr: Port von arduino/sketchbook/03-clap-led (Stand Abschnitt 44),
 * als Test fuer den Mikrofonpfad vor dem Modell. Gleiche Konsolenzeilen, damit tools/live_viewer.py passt:
 *   L,<max RMS im 100-ms-Fenster>,<Grundrauschen>        10x pro Sekunde
 *   KLATSCH #n  Dauer d ms  Peak p  xR  LED1 an|aus  ZCR z  Abkl. a ms
 *   VERWORFEN  Dauer d ms  Peak p  xR  Grund: ...  ZCR z  Abkl. a ms
 */
#include <zephyr/kernel.h>
#include <zephyr/drivers/gpio.h>
#include <zephyr/sys/printk.h>
#include <math.h>
#include "mic.h"

#define BLOCK            128
#define ONSET_RATIO      6.0f
#define QUIET_RATIO      2.0f
#define END_FRACTION     0.10f
#define SUDDEN_FACTOR    3.0f
#define MIN_RMS          300.0f
#define MIN_PEAK_RMS     1500.0f
#define MIN_CLAP_MS      24
#define MAX_CLAP_MS      150
#define ABORT_MS         400
#define REFRACTORY_MS    400
#define FLOOR_ALPHA      0.02f

static const struct gpio_dt_spec led1 = GPIO_DT_SPEC_GET(DT_ALIAS(led0), gpios);
static const struct gpio_dt_spec led2 = GPIO_DT_SPEC_GET(DT_NODELABEL(user_led1), gpios);

static int16_t pcm[BLOCK]; static size_t fill;
static float noiseFloor = 500.0f, prevRms = 0.0f, peakRms = 0.0f, peakRatio = 0.0f, windowMax = 0.0f;
static uint32_t peakZcr = 0; static bool inPulse = false;
static int64_t pulseStartMs = 0, lastClapMs = 0, led2OffMs = 0, lastLevelMs = 0, endFloorMs = 0;
static uint32_t claps = 0, blocks = 0; static bool led1on = false;

static void reject(uint32_t dur, uint32_t decay, const char *why)
{
	printk("VERWORFEN  Dauer %u ms  Peak %d  x%.1f  Grund: %s  ZCR %u  Abkl. %u ms\n", dur, (int)peakRms, (double)peakRatio, why, peakZcr, decay);
}

static void process_block(const int16_t *s, size_t n)
{
	int64_t sum = 0; for (size_t i = 0; i < n; i++) sum += s[i];
	float mean = (float)sum / n, acc = 0.0f; uint32_t zcr = 0;
	for (size_t i = 0; i < n; i++) { float d = s[i] - mean; acc += d * d; if (i && ((s[i] - mean) < 0) != ((s[i - 1] - mean) < 0)) zcr++; }
	float rms = sqrtf(acc / n); blocks++;
	float ratio = rms / noiseFloor; int64_t now = k_uptime_get();

	if (!inPulse) {
		if (ratio < ONSET_RATIO) noiseFloor += FLOOR_ALPHA * (rms - noiseFloor);
		if (noiseFloor < 50.0f) noiseFloor = 50.0f;
		bool loud = ratio >= ONSET_RATIO && rms >= MIN_RMS, sudden = prevRms * SUDDEN_FACTOR <= rms, free = now - lastClapMs >= REFRACTORY_MS;
		if (loud && sudden && free) { inPulse = true; pulseStartMs = now; peakRms = rms; peakRatio = ratio; peakZcr = zcr; endFloorMs = 0; }
	} else {
		uint32_t dur = (uint32_t)(now - pulseStartMs);
		if (rms > peakRms) { peakRms = rms; peakZcr = zcr; }
		if (ratio > peakRatio) peakRatio = ratio;
		if (ratio < QUIET_RATIO && endFloorMs == 0) endFloorMs = now;
		if (rms < peakRms * END_FRACTION || ratio < QUIET_RATIO) {
			inPulse = false;
			uint32_t decay = endFloorMs ? (uint32_t)(endFloorMs - pulseStartMs) : dur;
			if (dur < MIN_CLAP_MS) reject(dur, decay, "zu kurz (Schnipsen, Klicken)");
			else if (peakRms < MIN_PEAK_RMS) reject(dur, decay, "zu leise");
			else if (dur > MAX_CLAP_MS) reject(dur, decay, "zu lang");
			else {
				claps++; lastClapMs = now; led1on = !led1on; gpio_pin_set_dt(&led1, led1on); gpio_pin_set_dt(&led2, 1); led2OffMs = now + 80;
				printk("KLATSCH #%u  Dauer %u ms  Peak %d  x%.1f  LED1 %s  ZCR %u  Abkl. %u ms\n", claps, dur, (int)peakRms, (double)peakRatio, led1on ? "an" : "aus", peakZcr, decay);
			}
		} else if (dur > ABORT_MS) { inPulse = false; reject(dur, dur, "Dauerlaerm"); }
	}
	prevRms = rms;
	if (rms > windowMax) windowMax = rms;
	if (now - lastLevelMs >= 100) { lastLevelMs = now; printk("L,%d,%d\n", (int)windowMax, (int)noiseFloor); windowMax = 0; }
}

int main(void)
{
	gpio_pin_configure_dt(&led1, GPIO_OUTPUT_INACTIVE); gpio_pin_configure_dt(&led2, GPIO_OUTPUT_INACTIVE);
	printk("\nKlatsch-Schalter (regelbasiert) unter Zephyr\n");
	int err = mic_init();
	if (err) { printk("FEHLER: Mikrofon %d\n", err); for (;;) { gpio_pin_toggle_dt(&led2); k_msleep(100); } }
	printk("Mikrofon laeuft: 16 kHz mono, Bloecke von 8 ms\n");
	int16_t tmp[256];
	for (;;) {
		if (led2OffMs && k_uptime_get() >= led2OffMs) { gpio_pin_set_dt(&led2, 0); led2OffMs = 0; }
		size_t n = mic_read(tmp, 256);
		for (size_t i = 0; i < n; i++) { pcm[fill++] = tmp[i]; if (fill == BLOCK) { process_block(pcm, BLOCK); fill = 0; } }
		if (n == 0) k_msleep(2);
		static int64_t lastDiag; if (k_uptime_get() - lastDiag >= 2000) { lastDiag = k_uptime_get(); printk("DIAG bloecke=%u fifo=%u\n", blocks, (unsigned)mic_fifo_count()); }
	}
	return 0;
}
```

## src/cyhal_dma_stub.c
```c
/*
 * Stubs fuer den HAL-DMA-Treiber. cyhal_pdmpcm.c referenziert DMA nur fuer den asynchronen Lesepfad
 * (cyhal_pdm_pcm_read_async), den diese Anwendung nicht benutzt; gelesen wird synchron aus dem FIFO.
 * Zephyr baut den HAL-DMA-Treiber fuer CAT1A nicht mit, daher diese leeren Implementierungen.
 */
#include "cyhal_dma.h"

void cyhal_dma_free(cyhal_dma_t *obj) { (void)obj; }
bool cyhal_dma_is_busy(cyhal_dma_t *obj) { (void)obj; return false; }
void cyhal_dma_enable_event(cyhal_dma_t *obj, cyhal_dma_event_t event, uint8_t intr_priority, bool enable) { (void)obj; (void)event; (void)intr_priority; (void)enable; }
cy_rslt_t cyhal_dma_configure(cyhal_dma_t *obj, const cyhal_dma_cfg_t *cfg) { (void)obj; (void)cfg; return CYHAL_DMA_RSLT_ERR_INVALID_PARAMETER; }
cy_rslt_t cyhal_dma_enable(cyhal_dma_t *obj) { (void)obj; return CYHAL_DMA_RSLT_ERR_INVALID_PARAMETER; }
cy_rslt_t cyhal_dma_start_transfer(cyhal_dma_t *obj) { (void)obj; return CYHAL_DMA_RSLT_ERR_INVALID_PARAMETER; }
```

## src/mic.c
```c
#include "mic.h"
#include <zephyr/kernel.h>
#include <zephyr/sys/printk.h>
#include "cyhal_clock.h"
#include "cyhal_pdmpcm.h"
#include "cyhal_hw_types.h"

/* Pins laut Infineon-BSP: PDM_CLK P10.4, PDM_DATA P10.5 */
#define MIC_PIN_CLK   P10_4
#define MIC_PIN_DATA  P10_5
#define AUDIO_SYS_CLOCK_HZ 24576000u     /* wie in Infineons Arduino-PDM-Bibliothek */

static cyhal_clock_t pll_clock, audio_clock;
static cyhal_pdm_pcm_t pdm;
static int32_t fifo_buf[256];
static uint32_t overflows;

int mic_init(void)
{
	cy_rslt_t r;
	/* Takt: PLL0 auf 24,576 MHz, HF1 (Audio-Subsystem) daraus speisen. Zephyr nutzt die FLL fuer HF0, PLL0 ist frei. */
	r = cyhal_clock_reserve(&pll_clock, &CYHAL_CLOCK_PLL[0]);
	if (r != CY_RSLT_SUCCESS) { printk("mic: PLL reserve 0x%08x\n", (unsigned)r); return -1; }
	r = cyhal_clock_set_frequency(&pll_clock, AUDIO_SYS_CLOCK_HZ, NULL);
	if (r != CY_RSLT_SUCCESS) { printk("mic: PLL freq 0x%08x\n", (unsigned)r); return -2; }
	r = cyhal_clock_set_enabled(&pll_clock, true, true);
	if (r != CY_RSLT_SUCCESS) { printk("mic: PLL enable 0x%08x\n", (unsigned)r); return -3; }
	r = cyhal_clock_reserve(&audio_clock, &CYHAL_CLOCK_HF[1]);
	if (r != CY_RSLT_SUCCESS) { printk("mic: HF1 reserve 0x%08x\n", (unsigned)r); return -4; }
	r = cyhal_clock_set_source(&audio_clock, &pll_clock);
	if (r != CY_RSLT_SUCCESS) { printk("mic: HF1 source 0x%08x\n", (unsigned)r); return -5; }
	r = cyhal_clock_set_enabled(&audio_clock, true, true);
	if (r != CY_RSLT_SUCCESS) { printk("mic: HF1 enable 0x%08x\n", (unsigned)r); return -6; }

	const cyhal_pdm_pcm_cfg_t cfg = {
		.sample_rate = MIC_RATE,
		.decimation_rate = 64,
		.mode = CYHAL_PDM_PCM_MODE_LEFT,
		.word_length = 16,
		.left_gain = 20,
		.right_gain = 20,
	};
	r = cyhal_pdm_pcm_init(&pdm, MIC_PIN_DATA, MIC_PIN_CLK, &audio_clock, &cfg);
	if (r != CY_RSLT_SUCCESS) { printk("mic: pdm init 0x%08x\n", (unsigned)r); return -7; }
	r = cyhal_pdm_pcm_start(&pdm);
	if (r != CY_RSLT_SUCCESS) { printk("mic: pdm start 0x%08x\n", (unsigned)r); return -8; }
	return 0;
}

size_t mic_read(int16_t *dst, size_t max_samples)
{
	size_t n = max_samples < 256 ? max_samples : 256;
	if (cyhal_pdm_pcm_read(&pdm, fifo_buf, &n) != CY_RSLT_SUCCESS) return 0;
	for (size_t i = 0; i < n; i++) dst[i] = (int16_t)fifo_buf[i];
	return n;
}

uint32_t mic_overflows(void) { return overflows; }
```

## src/mic.h
```c
/* PDM-Mikrofon des CY8CKIT-062S2-AI ueber die Infineon-HAL, 16 kHz mono, 16 Bit. */
#ifndef MIC_H
#define MIC_H
#include <stdint.h>
#include <stddef.h>

#define MIC_RATE 16000

int mic_init(void);                               /* Audio-Takt (PLL0 24,576 MHz -> HF1) und PDM/PCM starten */
size_t mic_read(int16_t *dst, size_t max_samples);  /* so viele Samples wie im FIFO liegen, bis max */
uint32_t mic_overflows(void);
uint32_t mic_fifo_count(void);
#endif
```
